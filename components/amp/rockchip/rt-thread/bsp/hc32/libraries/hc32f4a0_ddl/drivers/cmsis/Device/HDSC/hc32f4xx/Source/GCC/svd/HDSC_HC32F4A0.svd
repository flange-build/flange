# HDSC_HC32F4A0 register map
Vendor: HDSC; Series: ARMCM4; File version: 1.0
CPU: CM4 r0p1, little endian, MPU, FPU, 4 interrupt priority bits
Registers are 32-bit, read-write, reset 0x0 unless marked. A register's access mark holds for its fields unless they carry their own. Offsets are from the block's base; lines under a group give offsets from that group; [hi:lo] are bit positions; {n}, {i} and the like mark numbered series; 'fields as' and 'values as' point back to an identical list; <NAME> marks a mode.

## Memory map
0x00000400 ICG size 0x10
0x40008000 AES size 0x40
0x40008400 HASH size 0x80
0x40008C00 CRC size 0x100
0x40009000 CAN1 size 0xCA — desc CAN
0x40010400 EFM size 0x1B0
0x40010600 OTS size 0x3A20C
0x40010800 AOS size 0x174
0x40017C00 EMB0 size 0x1C — desc EMB
0x40017C20 EMB1 size 0x1C — desc EMB
0x40017C40 EMB2 size 0x1C — desc EMB
0x40017C60 EMB3 size 0x1C — desc EMB
0x40017C80 EMB4 size 0x1C — desc EMB
0x40017CA0 EMB5 size 0x1C — desc EMB
0x40017CC0 EMB6 size 0x1C — desc EMB
{0x40008C00+0x400*n} TMR{n} size 0x1A0 (n=61..68) — desc TMR6
0x40018000 TMR6CR size 0x400
0x4001C000 SPI1 size 0x1C — desc SPI
0x4001C400 SPI2 size 0x1C — desc SPI
0x4001C800 SPI3 size 0x1C — desc SPI
0x4001CC00 USART1 size 0x1C — desc USART
0x4001D000 USART2 size 0x1C — desc USART
0x4001D400 USART3 size 0x1C — desc USART
0x4001D800 USART4 size 0x1C — desc USART
0x4001DC00 USART5 size 0x20 — desc USART
0x4001E000 I2S1 size 0x1C — desc I2S
0x4001E400 I2S2 size 0x1C — desc I2S
0x40020000 SPI4 size 0x1C — desc SPI
0x40020400 SPI5 size 0x1C — desc SPI
0x40020800 SPI6 size 0x1C — desc SPI
0x40020C00 USART6 size 0x1C
0x40021000 USART7 size 0x1C — desc USART
0x40021400 USART8 size 0x1C — desc USART
0x40021800 USART9 size 0x1C — desc USART
0x40021C00 USART10 size 0x20
0x40022000 I2S3 size 0x1C — desc I2S
0x40022400 I2S4 size 0x1C — desc I2S
0x40024000 TMR01 size 0x18 — desc TMR0
0x40024400 TMR02 size 0x18 — desc TMR0
0x40024800 TMR21 size 0x24 — desc TMR2
0x40024C00 TMR22 size 0x24 — desc TMR2
0x40025000 TMR23 size 0x24 — desc TMR2
0x40025400 TMR24 size 0x24 — desc TMR2
{0x40024C00+0x400*n} TMRA{n} size 0x150 (n=5..12) — desc TMRA
0x40038000 TMR41 size 0xE6 — desc TMR4
0x40038400 TMR42 size 0xE6 — desc TMR4
0x40038800 TMR43 size 0xE6 — desc TMR4
0x4003A000 TMRA1 size 0x150 — desc TMRA
0x4003A400 TMRA2 size 0x150 — desc TMRA
0x4003A800 TMRA3 size 0x150 — desc TMRA
0x4003AC00 TMRA4 size 0x150 — desc TMRA
0x4003C000 HRPWM size 0x58
0x40040000 ADC1 size 0xC5
0x40040400 ADC2 size 0xC5
0x40040800 ADC3 size 0xB1
0x40041000 DAC1 size 0x1E — desc DAC
0x40041400 DAC2 size 0x1E — desc DAC
0x40042000 TRNG size 0x14
0x40048000 PWC size 0xC400
0x40048400 FCM size 0x24
0x40049000 WDT size 0xC
0x40049400 SWDT size 0xC
0x40049C00 CTC size 0xC
0x4004A000 CMP1 size 0xA — desc CMP
0x4004A010 CMP2 size 0xA — desc CMP
0x4004A400 CMP3 size 0xA — desc CMP
0x4004A410 CMP4 size 0xA — desc CMP
0x4004C000 RTC size 0x60
0x4004C400 CMU size 0x7D08
0x4004CC00 RMU size 0x100
0x4004E000 I2C1 size 0x34 — desc I2C
0x4004E400 I2C2 size 0x34 — desc I2C
0x4004E800 I2C3 size 0x34 — desc I2C
0x4004EC00 I2C4 size 0x34 — desc I2C
0x4004F000 I2C5 size 0x34 — desc I2C
0x4004F400 I2C6 size 0x34 — desc I2C
0x40050000 ETH size 0x11058
0x40050000 MPU size 0xA0
0x40050800 SRAMC size 0x14
0x40050C00 KEYSCAN size 0xC
0x40051000 INTC size 0x2B4
0x40053000 DMA1 size 0x238 — desc DMA
0x40053400 DMA2 size 0x238 — desc DMA
0x40053800 GPIO size 0x638
0x40055000 MAU size 0x18
0x40055400 PERIC size 0x2C
0x40055800 DVP size 0x30
{0x40055C00+0x400*n} DCU{n} size 0x1C (n=1..8) — desc DCU
0x40058000 FMAC1 size 0x64 — desc FMAC
0x40058400 FMAC2 size 0x64 — desc FMAC
0x40058800 FMAC3 size 0x64 — desc FMAC
0x40058C00 FMAC4 size 0x64 — desc FMAC
0x40070000 SDIOC1 size 0x54 — desc SDIOC
0x40078000 CAN2 size 0xCA — desc CAN
0x40078400 SDIOC2 size 0x54 — desc SDIOC
0x40080000 USBFS size 0xE04
0x400C0000 USBHS size 0xE04
0x88000000 SMC size 0x210
0x88000400 DMC size 0x304
0x88100000 NFC size 0x8180
0x9C000000 QSPI size 0x808
0xE0042000 DBGC size 0x2C
