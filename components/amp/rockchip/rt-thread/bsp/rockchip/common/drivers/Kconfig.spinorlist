## components/amp/rockchip/rt-thread/bsp/rockchip/common/drivers/Kconfig.spinorlist
```kconfig
if RT_USING_SNOR

config RT_SNOR_DEVICE_AUTOSELECT
    bool "Autoselect SPI Nor flash"
    default y
    help
      By default, auto-selects all SPI Nor flash chips.

menu "SPI Nor flash"
    visible if !RT_SNOR_DEVICE_AUTOSELECT

config RT_SNOR_BOYA
    bool "BOYA SPI flash support"
    default y if RT_SNOR_DEVICE_AUTOSELECT
    help
      Add support for various BOYA SPI flash chips (BY25xxx)

config RT_SNOR_DOSILICON
    bool "DOSILICON SPI flash support"
    default y if RT_SNOR_DEVICE_AUTOSELECT
    help
      Add support for various DOSILICON SPI flash chips (FM25xxx)

config RT_SNOR_EON
    bool "EON SPI flash support"
    default y if RT_SNOR_DEVICE_AUTOSELECT
    help
      Add support for various EON SPI flash chips (EN25xxx)

config RT_SNOR_ESMT
    bool "ESMT SPI flash support"
    default y if RT_SNOR_DEVICE_AUTOSELECT
    help
      Add support for various ESMT SPI flash chips (F25xxx and EN25)

config RT_SNOR_FMSH
    bool "FMSH SPI flash support"
    default y if RT_SNOR_DEVICE_AUTOSELECT
    help
      Add support for various FMSH SPI flash chips (FM25xxx)

config RT_SNOR_GIGADEVICE
    bool "GigaDevice SPI flash support"
    default y if RT_SNOR_DEVICE_AUTOSELECT
    help
      Add support for various GigaDevice SPI flash chips (GD25xxx)

config RT_SNOR_ISSI
    bool "ISSI SPI flash support"
    default y if RT_SNOR_DEVICE_AUTOSELECT
    help
      Add support for various ISSI SPI flash chips (ISxxx)

config RT_SNOR_MACRONIX
    bool "Macronix SPI flash support"
    default y if RT_SNOR_DEVICE_AUTOSELECT
    help
      Add support for various Macronix SPI flash chips (MX25Lxxx)

config RT_SNOR_NORMEM
    bool "NORMEM SPI flash support"
    default y if RT_SNOR_DEVICE_AUTOSELECT
    help
      Add support for various NORMEM SPI flash chips (NM25xxx)

config RT_SNOR_PUYA
    bool "PUYA SPI flash support"
    default y if RT_SNOR_DEVICE_AUTOSELECT
    help
      Add support for various PUYA SPI flash chips (PY25xxx)

config RT_SNOR_WINBOND
    bool "Winbond SPI flash support"
    default y if RT_SNOR_DEVICE_AUTOSELECT
    help
      Add support for various WINBOND SPI flash chips (W25xxx)

config RT_SNOR_XMC
    bool "XMC SPI flash support"
    default y if RT_SNOR_DEVICE_AUTOSELECT
    help
      Add support for various XMC SPI flash chips (XM25xxx)

config RT_SNOR_XTX
    bool "XTX SPI flash support"
    default y if RT_SNOR_DEVICE_AUTOSELECT
    help
      Add support for various XTX SPI flash chips (XT25xxx)

config RT_SNOR_ZBIT
    bool "ZBIT SPI flash support"
    default y if RT_SNOR_DEVICE_AUTOSELECT
    help
      Add support for various ZBIT SPI flash chips (ZB25xxx)

endmenu

endif # RT_SNOR
```

## components/amp/rockchip/rt-thread/bsp/rockchip/common/drivers/leds/Kconfig
```kconfig
menu "led driver"
config RT_USING_LEDS
    bool
    default n

    config RT_USING_WS28XX
        depends on RT_USING_LEDS
        bool "ws28xx (one wire protocol) driver select"
        default n

    config RT_USING_AW210XX
        depends on RT_USING_LEDS
        bool "aw210xx driver select"
        default n

    config RT_USING_IS31FL32XX
        depends on RT_USING_LEDS
        bool "is31fl32xx driver select"
        default n
endmenu
```

## components/amp/rockchip/rt-thread/bsp/rockchip/rk2116/board/Kconfig
```kconfig
menu "RT-Thread board config"

config IS_FPGA
    bool "Is FPGA Board"
    default n

choice
    prompt "Board Type"
    default RT_USING_BOARD_FPGA

    config RT_USING_BOARD_FPGA
        bool "Enable FPGA board"
        select IS_FPGA
endchoice

config RT_USING_HIFI4
    bool "Enable hifi4 driver"
    default n

    if RT_USING_HIFI4
        config RT_USING_HIFI4_FW_BUILTIN
        bool "hifi4 firmware builtin"
        default n
    endif

source "$BSP_DIR/../common/fwmgr/Kconfig"
endmenu
```

## components/amp/rockchip/rt-thread/bsp/rockchip/rk2118/Kconfig
```kconfig
mainmenu "RT-Thread Configuration"

config BSP_DIR
    string
    option env = "BSP_ROOT"
    default "."

config RTT_DIR
    string
    option env = "RTT_ROOT"
    default "../../.."

config PKGS_DIR
    string
    option env = "PKGS_ROOT"
    default "packages"

config ARCH_ARM_CORTEX_M33
    bool
    default y

config ARM_CM33_ENABLE_TRUSTZONE
    bool
    default n

config RKMCU_RK2118
    bool
    select ARCH_ARM_CORTEX_M33
    default y

choice
    prompt "RK2118 cpu core select"
    default RK2118_CPU_CORE0

    config RK2118_CPU_CORE0
        bool "STAR-MC1 CORE0"

    config RK2118_CPU_CORE1
        bool "STAR-MC1 CORE1"

endchoice

choice
    prompt "CPU running space"
    default CPU_RUN_IN_XIP

    config CPU_RUN_IN_XIP
        bool "cpu running in XIP flash"

    config CPU_RUN_IN_SRAM
        bool "cpu running in sram"

    config CPU_RUN_IN_DDR
        bool "cpu running in DDR"

endchoice   

config ARCH_ARM_CORTEX_SECURE
    bool "STAR-MC1 Core0 run in security context"
    select RK2118_CPU_CORE0
    default n

config PM_HAS_CUSTOM_CONFIG
    bool
    depends on RT_USING_PM
    default n

source "$RTT_DIR/Kconfig"

menuconfig RT_USING_PKGS
    bool "Enable RT-Thread online packages"

if RT_USING_PKGS
    source "$PKGS_DIR/Kconfig"
endif

source "$BSP_DIR/drivers/Kconfig"
source "$BSP_DIR/board/Kconfig"
source "$BSP_DIR/../common/tests/Kconfig"
```

## components/amp/rockchip/rt-thread/bsp/rockchip/rk3568-32/driver/Kconfig
```kconfig
source "$BSP_DIR/../common/drivers/Kconfig"

menu "RT-Thread rockchip RK3568 drivers"

config RT_USING_CACHE_ECC
    bool "Enable Cache ECC"
    default n

menu "Enable CAN"
    config RT_USING_CAN
        bool "Enable CAN"
        default n

    if RT_USING_CAN
    config RT_USING_CAN1
        bool "Enable CAN1"
        default n
    endif
endmenu

config RT_USING_CRU
    bool "Enable CRU"
    default n

menu "Enable GMAC"
    config RT_USING_GMAC
        bool "Enable GMAC"
        select RT_USING_LWIP
        default n

    if RT_USING_GMAC
    config RT_USING_GMAC0
        bool "Enable GMAC0"
        default n
    config RT_USING_GMAC1
        bool "Enable GMAC1"
        default n
    endif
endmenu

config RT_USING_I2C0
    bool "Enable I2C0"
    select RT_USING_I2C
    default n

config RT_USING_SYSTICK
    bool "Enable SYSTICK"
    default y

menu "Enable UART"
    config RT_USING_UART
        bool "Enable UART"
        default y

    if RT_USING_UART
    config RT_USING_UART2
        bool "Enable UART2"
        default y

    config RT_USING_UART4
        bool "Enable UART4"
        default n
    endif
endmenu

config RT_USING_DW_PCIE
    bool "Enable DW PCIE"
    default n

config RT_USING_PCIE_DMA
    bool "Enable PCIE DMA"
    default n

config RT_USING_WITH_LINUX
    bool "Enable USING WITH LINUX"
    default n
endmenu
```

## components/amp/rockchip/rt-thread/components/system/Kconfig
```kconfig
menu "System"

config RT_USING_LVGL
	bool "LVGL: Light and Versatile Graphics Library"
	default n
	help
	  Enable LVGL.

	choice LVGL_VERSION
		prompt "LVGL Version."
		default RT_USING_LVGL8
		depends on RT_USING_LVGL
		help
		  Select LVGL version.

		config RT_USING_LVGL8
			bool "v8.x"
		config RT_USING_LVGL9
			bool "v9.x"
	endchoice

if RT_USING_LVGL8
	source "$RTT_DIR/components/system/lvgl/Kconfig"
	source "$RTT_DIR/components/system/lvgl/Kconfig.rtt"
endif

if RT_USING_LVGL9
	source "$RTT_DIR/components/system/lvgl9/Kconfig"
	source "$RTT_DIR/components/system/lvgl9/Kconfig.rtt"
endif

config RT_USING_FREETYPE
	bool "FreeType Font Library Enable"
	default n
	help
	  Enable Freetype.

endmenu
```
