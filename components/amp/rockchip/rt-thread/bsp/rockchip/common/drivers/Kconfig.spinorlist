## components/amp/rockchip/rt-thread/components/system/lvgl9/Kconfig.rtt
```kconfig
# Kconfig.rtt, convert bool to int

config LV_CONF_SKIP
	int
	default 0 if !RT_LV_CONF_SKIP
	default 1 if RT_LV_CONF_SKIP

config LV_CONF_MINIMAL
	int
	default 0 if !RT_LV_CONF_MINIMAL
	default 1 if RT_LV_CONF_MINIMAL

config LV_USE_FREERTOS_TASK_NOTIFY
	int
	default 0 if !RT_LV_USE_FREERTOS_TASK_NOTIFY
	default 1 if RT_LV_USE_FREERTOS_TASK_NOTIFY

config LV_DRAW_TRANSFORM_USE_MATRIX
	int
	default 0 if !RT_LV_DRAW_TRANSFORM_USE_MATRIX
	default 1 if RT_LV_DRAW_TRANSFORM_USE_MATRIX

config LV_USE_DRAW_SW
	int
	default 0 if !RT_LV_USE_DRAW_SW
	default 1 if RT_LV_USE_DRAW_SW

config LV_DRAW_SW_SUPPORT_RGB565
	int
	default 0 if !RT_LV_DRAW_SW_SUPPORT_RGB565
	default 1 if RT_LV_DRAW_SW_SUPPORT_RGB565

config LV_DRAW_SW_SUPPORT_RGB565A8
	int
	default 0 if !RT_LV_DRAW_SW_SUPPORT_RGB565A8
	default 1 if RT_LV_DRAW_SW_SUPPORT_RGB565A8

config LV_DRAW_SW_SUPPORT_RGB888
	int
	default 0 if !RT_LV_DRAW_SW_SUPPORT_RGB888
	default 1 if RT_LV_DRAW_SW_SUPPORT_RGB888

config LV_DRAW_SW_SUPPORT_XRGB8888
	int
	default 0 if !RT_LV_DRAW_SW_SUPPORT_XRGB8888
	default 1 if RT_LV_DRAW_SW_SUPPORT_XRGB8888

config LV_DRAW_SW_SUPPORT_ARGB8888
	int
	default 0 if !RT_LV_DRAW_SW_SUPPORT_ARGB8888
	default 1 if RT_LV_DRAW_SW_SUPPORT_ARGB8888

config LV_DRAW_SW_SUPPORT_L8
	int
	default 0 if !RT_LV_DRAW_SW_SUPPORT_L8
	default 1 if RT_LV_DRAW_SW_SUPPORT_L8

config LV_DRAW_SW_SUPPORT_AL88
	int
	default 0 if !RT_LV_DRAW_SW_SUPPORT_AL88
	default 1 if RT_LV_DRAW_SW_SUPPORT_AL88

config LV_DRAW_SW_SUPPORT_A8
	int
	default 0 if !RT_LV_DRAW_SW_SUPPORT_A8
	default 1 if RT_LV_DRAW_SW_SUPPORT_A8

config LV_DRAW_SW_SUPPORT_I1
	int
	default 0 if !RT_LV_DRAW_SW_SUPPORT_I1
	default 1 if RT_LV_DRAW_SW_SUPPORT_I1

config LV_USE_DRAW_ARM2D_SYNC
	int
	default 0 if !RT_LV_USE_DRAW_ARM2D_SYNC
	default 1 if RT_LV_USE_DRAW_ARM2D_SYNC

config LV_USE_NATIVE_HELIUM_ASM
	int
	default 0 if !RT_LV_USE_NATIVE_HELIUM_ASM
	default 1 if RT_LV_USE_NATIVE_HELIUM_ASM

config LV_DRAW_SW_COMPLEX
	int
	default 0 if !RT_LV_DRAW_SW_COMPLEX
	default 1 if RT_LV_DRAW_SW_COMPLEX

config LV_USE_DRAW_SW_COMPLEX_GRADIENTS
	int
	default 0 if !RT_LV_USE_DRAW_SW_COMPLEX_GRADIENTS
	default 1 if RT_LV_USE_DRAW_SW_COMPLEX_GRADIENTS

config LV_USE_DRAW_VGLITE
	int
	default 0 if !RT_LV_USE_DRAW_VGLITE
	default 1 if RT_LV_USE_DRAW_VGLITE

config LV_USE_VGLITE_BLIT_SPLIT
	int
	default 0 if !RT_LV_USE_VGLITE_BLIT_SPLIT
	default 1 if RT_LV_USE_VGLITE_BLIT_SPLIT

config LV_USE_VGLITE_DRAW_THREAD
	int
	default 0 if !RT_LV_USE_VGLITE_DRAW_THREAD
	default 1 if RT_LV_USE_VGLITE_DRAW_THREAD

config LV_USE_VGLITE_DRAW_ASYNC
	int
	default 0 if !RT_LV_USE_VGLITE_DRAW_ASYNC
	default 1 if RT_LV_USE_VGLITE_DRAW_ASYNC

config LV_USE_VGLITE_ASSERT
	int
	default 0 if !RT_LV_USE_VGLITE_ASSERT
	default 1 if RT_LV_USE_VGLITE_ASSERT

config LV_USE_PXP
	int
	default 0 if !RT_LV_USE_PXP
	default 1 if RT_LV_USE_PXP

config LV_USE_DRAW_PXP
	int
	default 0 if !RT_LV_USE_DRAW_PXP
	default 1 if RT_LV_USE_DRAW_PXP

config LV_USE_ROTATE_PXP
	int
	default 0 if !RT_LV_USE_ROTATE_PXP
	default 1 if RT_LV_USE_ROTATE_PXP

config LV_USE_PXP_DRAW_THREAD
	int
	default 0 if !RT_LV_USE_PXP_DRAW_THREAD
	default 1 if RT_LV_USE_PXP_DRAW_THREAD

config LV_USE_PXP_ASSERT
	int
	default 0 if !RT_LV_USE_PXP_ASSERT
	default 1 if RT_LV_USE_PXP_ASSERT

config LV_USE_DRAW_DAVE2D
	int
	default 0 if !RT_LV_USE_DRAW_DAVE2D
	default 1 if RT_LV_USE_DRAW_DAVE2D

config LV_USE_DRAW_SDL
	int
	default 0 if !RT_LV_USE_DRAW_SDL
	default 1 if RT_LV_USE_DRAW_SDL

config LV_USE_DRAW_VG_LITE
	int
	default 0 if !RT_LV_USE_DRAW_VG_LITE
	default 1 if RT_LV_USE_DRAW_VG_LITE

config LV_VG_LITE_USE_GPU_INIT
	int
	default 0 if !RT_LV_VG_LITE_USE_GPU_INIT
	default 1 if RT_LV_VG_LITE_USE_GPU_INIT

config LV_VG_LITE_USE_ASSERT
	int
	default 0 if !RT_LV_VG_LITE_USE_ASSERT
	default 1 if RT_LV_VG_LITE_USE_ASSERT

config LV_VG_LITE_USE_BOX_SHADOW
	int
	default 0 if !RT_LV_VG_LITE_USE_BOX_SHADOW
	default 1 if RT_LV_VG_LITE_USE_BOX_SHADOW

config LV_USE_VECTOR_GRAPHIC
	int
	default 0 if !RT_LV_USE_VECTOR_GRAPHIC
	default 1 if RT_LV_USE_VECTOR_GRAPHIC

config LV_USE_LOG
	int
	default 0 if !RT_LV_USE_LOG
	default 1 if RT_LV_USE_LOG

config LV_LOG_PRINTF
	int
	default 0 if !RT_LV_LOG_PRINTF
	default 1 if RT_LV_LOG_PRINTF

config LV_LOG_USE_TIMESTAMP
	int
	default 0 if !RT_LV_LOG_USE_TIMESTAMP
	default 1 if RT_LV_LOG_USE_TIMESTAMP

config LV_LOG_USE_FILE_LINE
	int
	default 0 if !RT_LV_LOG_USE_FILE_LINE
	default 1 if RT_LV_LOG_USE_FILE_LINE

config LV_LOG_TRACE_MEM
	int
	default 0 if !RT_LV_LOG_TRACE_MEM
	default 1 if RT_LV_LOG_TRACE_MEM

config LV_LOG_TRACE_TIMER
	int
	default 0 if !RT_LV_LOG_TRACE_TIMER
	default 1 if RT_LV_LOG_TRACE_TIMER

config LV_LOG_TRACE_INDEV
	int
	default 0 if !RT_LV_LOG_TRACE_INDEV
	default 1 if RT_LV_LOG_TRACE_INDEV

config LV_LOG_TRACE_DISP_REFR
	int
	default 0 if !RT_LV_LOG_TRACE_DISP_REFR
	default 1 if RT_LV_LOG_TRACE_DISP_REFR

config LV_LOG_TRACE_EVENT
	int
	default 0 if !RT_LV_LOG_TRACE_EVENT
	default 1 if RT_LV_LOG_TRACE_EVENT

config LV_LOG_TRACE_OBJ_CREATE
	int
	default 0 if !RT_LV_LOG_TRACE_OBJ_CREATE
	default 1 if RT_LV_LOG_TRACE_OBJ_CREATE

config LV_LOG_TRACE_LAYOUT
	int
	default 0 if !RT_LV_LOG_TRACE_LAYOUT
	default 1 if RT_LV_LOG_TRACE_LAYOUT

config LV_LOG_TRACE_ANIM
	int
	default 0 if !RT_LV_LOG_TRACE_ANIM
	default 1 if RT_LV_LOG_TRACE_ANIM

config LV_LOG_TRACE_CACHE
	int
	default 0 if !RT_LV_LOG_TRACE_CACHE
	default 1 if RT_LV_LOG_TRACE_CACHE

config LV_USE_ASSERT_NULL
	int
	default 0 if !RT_LV_USE_ASSERT_NULL
	default 1 if RT_LV_USE_ASSERT_NULL

config LV_USE_ASSERT_MALLOC
	int
	default 0 if !RT_LV_USE_ASSERT_MALLOC
	default 1 if RT_LV_USE_ASSERT_MALLOC

config LV_USE_ASSERT_STYLE
	int
	default 0 if !RT_LV_USE_ASSERT_STYLE
	default 1 if RT_LV_USE_ASSERT_STYLE

config LV_USE_ASSERT_MEM_INTEGRITY
	int
	default 0 if !RT_LV_USE_ASSERT_MEM_INTEGRITY
	default 1 if RT_LV_USE_ASSERT_MEM_INTEGRITY

config LV_USE_ASSERT_OBJ
	int
	default 0 if !RT_LV_USE_ASSERT_OBJ
	default 1 if RT_LV_USE_ASSERT_OBJ

config LV_USE_REFR_DEBUG
	int
	default 0 if !RT_LV_USE_REFR_DEBUG
	default 1 if RT_LV_USE_REFR_DEBUG

config LV_USE_LAYER_DEBUG
	int
	default 0 if !RT_LV_USE_LAYER_DEBUG
	default 1 if RT_LV_USE_LAYER_DEBUG

config LV_USE_PARALLEL_DRAW_DEBUG
	int
	default 0 if !RT_LV_USE_PARALLEL_DRAW_DEBUG
	default 1 if RT_LV_USE_PARALLEL_DRAW_DEBUG

config LV_ENABLE_GLOBAL_CUSTOM
	int
	default 0 if !RT_LV_ENABLE_GLOBAL_CUSTOM
	default 1 if RT_LV_ENABLE_GLOBAL_CUSTOM

config LV_OBJ_STYLE_CACHE
	int
	default 0 if !RT_LV_OBJ_STYLE_CACHE
	default 1 if RT_LV_OBJ_STYLE_CACHE

config LV_USE_OBJ_ID
	int
	default 0 if !RT_LV_USE_OBJ_ID
	default 1 if RT_LV_USE_OBJ_ID

config LV_OBJ_ID_AUTO_ASSIGN
	int
	default 0 if !RT_LV_OBJ_ID_AUTO_ASSIGN
	default 1 if RT_LV_OBJ_ID_AUTO_ASSIGN

config LV_USE_OBJ_ID_BUILTIN
	int
	default 0 if !RT_LV_USE_OBJ_ID_BUILTIN
	default 1 if RT_LV_USE_OBJ_ID_BUILTIN

config LV_USE_OBJ_PROPERTY
	int
	default 0 if !RT_LV_USE_OBJ_PROPERTY
	default 1 if RT_LV_USE_OBJ_PROPERTY

config LV_USE_OBJ_PROPERTY_NAME
	int
	default 0 if !RT_LV_USE_OBJ_PROPERTY_NAME
	default 1 if RT_LV_USE_OBJ_PROPERTY_NAME

config LV_USE_VG_LITE_THORVG
	int
	default 0 if !RT_LV_USE_VG_LITE_THORVG
	default 1 if RT_LV_USE_VG_LITE_THORVG

config LV_VG_LITE_THORVG_LVGL_BLEND_SUPPORT
	int
	default 0 if !RT_LV_VG_LITE_THORVG_LVGL_BLEND_SUPPORT
	default 1 if RT_LV_VG_LITE_THORVG_LVGL_BLEND_SUPPORT

config LV_VG_LITE_THORVG_YUV_SUPPORT
	int
	default 0 if !RT_LV_VG_LITE_THORVG_YUV_SUPPORT
	default 1 if RT_LV_VG_LITE_THORVG_YUV_SUPPORT

config LV_VG_LITE_THORVG_LINEAR_GRADIENT_EXT_SUPPORT
	int
	default 0 if !RT_LV_VG_LITE_THORVG_LINEAR_GRADIENT_EXT_SUPPORT
	default 1 if RT_LV_VG_LITE_THORVG_LINEAR_GRADIENT_EXT_SUPPORT

config LV_VG_LITE_THORVG_THREAD_RENDER
	int
	default 0 if !RT_LV_VG_LITE_THORVG_THREAD_RENDER
	default 1 if RT_LV_VG_LITE_THORVG_THREAD_RENDER

config LV_BIG_ENDIAN_SYSTEM
	int
	default 0 if !RT_LV_BIG_ENDIAN_SYSTEM
	default 1 if RT_LV_BIG_ENDIAN_SYSTEM

config LV_ATTRIBUTE_FAST_MEM_USE_IRAM
	int
	default 0 if !RT_LV_ATTRIBUTE_FAST_MEM_USE_IRAM
	default 1 if RT_LV_ATTRIBUTE_FAST_MEM_USE_IRAM

config LV_USE_FLOAT
	int
	default 0 if !RT_LV_USE_FLOAT
	default 1 if RT_LV_USE_FLOAT

config LV_USE_MATRIX
	int
	default 0 if !RT_LV_USE_MATRIX
	default 1 if RT_LV_USE_MATRIX

config LV_USE_PRIVATE_API
	int
	default 0 if !RT_LV_USE_PRIVATE_API
	default 1 if RT_LV_USE_PRIVATE_API

config LV_FONT_MONTSERRAT_8
	int
	default 0 if !RT_LV_FONT_MONTSERRAT_8
	default 1 if RT_LV_FONT_MONTSERRAT_8

config LV_FONT_MONTSERRAT_10
	int
	default 0 if !RT_LV_FONT_MONTSERRAT_10
	default 1 if RT_LV_FONT_MONTSERRAT_10

config LV_FONT_MONTSERRAT_12
	int
	default 0 if !RT_LV_FONT_MONTSERRAT_12
	default 1 if RT_LV_FONT_MONTSERRAT_12

config LV_FONT_MONTSERRAT_14
	int
	default 0 if !RT_LV_FONT_MONTSERRAT_14
	default 1 if RT_LV_FONT_MONTSERRAT_14

config LV_FONT_MONTSERRAT_16
	int
	default 0 if !RT_LV_FONT_MONTSERRAT_16
	default 1 if RT_LV_FONT_MONTSERRAT_16

config LV_FONT_MONTSERRAT_18
	int
	default 0 if !RT_LV_FONT_MONTSERRAT_18
	default 1 if RT_LV_FONT_MONTSERRAT_18

config LV_FONT_MONTSERRAT_20
	int
	default 0 if !RT_LV_FONT_MONTSERRAT_20
	default 1 if RT_LV_FONT_MONTSERRAT_20

config LV_FONT_MONTSERRAT_22
	int
	default 0 if !RT_LV_FONT_MONTSERRAT_22
	default 1 if RT_LV_FONT_MONTSERRAT_22

config LV_FONT_MONTSERRAT_24
	int
	default 0 if !RT_LV_FONT_MONTSERRAT_24
	default 1 if RT_LV_FONT_MONTSERRAT_24

config LV_FONT_MONTSERRAT_26
	int
	default 0 if !RT_LV_FONT_MONTSERRAT_26
	default 1 if RT_LV_FONT_MONTSERRAT_26

config LV_FONT_MONTSERRAT_28
	int
	default 0 if !RT_LV_FONT_MONTSERRAT_28
	default 1 if RT_LV_FONT_MONTSERRAT_28

config LV_FONT_MONTSERRAT_30
	int
	default 0 if !RT_LV_FONT_MONTSERRAT_30
	default 1 if RT_LV_FONT_MONTSERRAT_30

config LV_FONT_MONTSERRAT_32
	int
	default 0 if !RT_LV_FONT_MONTSERRAT_32
	default 1 if RT_LV_FONT_MONTSERRAT_32

config LV_FONT_MONTSERRAT_34
	int
	default 0 if !RT_LV_FONT_MONTSERRAT_34
	default 1 if RT_LV_FONT_MONTSERRAT_34

config LV_FONT_MONTSERRAT_36
	int
	default 0 if !RT_LV_FONT_MONTSERRAT_36
	default 1 if RT_LV_FONT_MONTSERRAT_36

config LV_FONT_MONTSERRAT_38
	int
	default 0 if !RT_LV_FONT_MONTSERRAT_38
	default 1 if RT_LV_FONT_MONTSERRAT_38

config LV_FONT_MONTSERRAT_40
	int
	default 0 if !RT_LV_FONT_MONTSERRAT_40
	default 1 if RT_LV_FONT_MONTSERRAT_40

config LV_FONT_MONTSERRAT_42
	int
	default 0 if !RT_LV_FONT_MONTSERRAT_42
	default 1 if RT_LV_FONT_MONTSERRAT_42

config LV_FONT_MONTSERRAT_44
	int
	default 0 if !RT_LV_FONT_MONTSERRAT_44
	default 1 if RT_LV_FONT_MONTSERRAT_44

config LV_FONT_MONTSERRAT_46
	int
	default 0 if !RT_LV_FONT_MONTSERRAT_46
	default 1 if RT_LV_FONT_MONTSERRAT_46

config LV_FONT_MONTSERRAT_48
	int
	default 0 if !RT_LV_FONT_MONTSERRAT_48
	default 1 if RT_LV_FONT_MONTSERRAT_48

config LV_FONT_MONTSERRAT_28_COMPRESSED
	int
	default 0 if !RT_LV_FONT_MONTSERRAT_28_COMPRESSED
	default 1 if RT_LV_FONT_MONTSERRAT_28_COMPRESSED

config LV_FONT_DEJAVU_16_PERSIAN_HEBREW
	int
	default 0 if !RT_LV_FONT_DEJAVU_16_PERSIAN_HEBREW
	default 1 if RT_LV_FONT_DEJAVU_16_PERSIAN_HEBREW

config LV_FONT_SIMSUN_14_CJK
	int
	default 0 if !RT_LV_FONT_SIMSUN_14_CJK
	default 1 if RT_LV_FONT_SIMSUN_14_CJK

config LV_FONT_SIMSUN_16_CJK
	int
	default 0 if !RT_LV_FONT_SIMSUN_16_CJK
	default 1 if RT_LV_FONT_SIMSUN_16_CJK

config LV_FONT_UNSCII_8
	int
	default 0 if !RT_LV_FONT_UNSCII_8
	default 1 if RT_LV_FONT_UNSCII_8

config LV_FONT_UNSCII_16
	int
	default 0 if !RT_LV_FONT_UNSCII_16
	default 1 if RT_LV_FONT_UNSCII_16

config LV_FONT_DEFAULT_MONTSERRAT_8
	int
	default 0 if !RT_LV_FONT_DEFAULT_MONTSERRAT_8
	default 1 if RT_LV_FONT_DEFAULT_MONTSERRAT_8

config LV_FONT_DEFAULT_MONTSERRAT_10
	int
	default 0 if !RT_LV_FONT_DEFAULT_MONTSERRAT_10
	default 1 if RT_LV_FONT_DEFAULT_MONTSERRAT_10

config LV_FONT_DEFAULT_MONTSERRAT_12
	int
	default 0 if !RT_LV_FONT_DEFAULT_MONTSERRAT_12
	default 1 if RT_LV_FONT_DEFAULT_MONTSERRAT_12

config LV_FONT_DEFAULT_MONTSERRAT_14
	int
	default 0 if !RT_LV_FONT_DEFAULT_MONTSERRAT_14
	default 1 if RT_LV_FONT_DEFAULT_MONTSERRAT_14

config LV_FONT_DEFAULT_MONTSERRAT_16
	int
	default 0 if !RT_LV_FONT_DEFAULT_MONTSERRAT_16
	default 1 if RT_LV_FONT_DEFAULT_MONTSERRAT_16

config LV_FONT_DEFAULT_MONTSERRAT_18
	int
	default 0 if !RT_LV_FONT_DEFAULT_MONTSERRAT_18
	default 1 if RT_LV_FONT_DEFAULT_MONTSERRAT_18

config LV_FONT_DEFAULT_MONTSERRAT_20
	int
	default 0 if !RT_LV_FONT_DEFAULT_MONTSERRAT_20
	default 1 if RT_LV_FONT_DEFAULT_MONTSERRAT_20

config LV_FONT_DEFAULT_MONTSERRAT_22
	int
	default 0 if !RT_LV_FONT_DEFAULT_MONTSERRAT_22
	default 1 if RT_LV_FONT_DEFAULT_MONTSERRAT_22

config LV_FONT_DEFAULT_MONTSERRAT_24
	int
	default 0 if !RT_LV_FONT_DEFAULT_MONTSERRAT_24
	default 1 if RT_LV_FONT_DEFAULT_MONTSERRAT_24

config LV_FONT_DEFAULT_MONTSERRAT_26
	int
	default 0 if !RT_LV_FONT_DEFAULT_MONTSERRAT_26
	default 1 if RT_LV_FONT_DEFAULT_MONTSERRAT_26

config LV_FONT_DEFAULT_MONTSERRAT_28
	int
	default 0 if !RT_LV_FONT_DEFAULT_MONTSERRAT_28
	default 1 if RT_LV_FONT_DEFAULT_MONTSERRAT_28

config LV_FONT_DEFAULT_MONTSERRAT_30
	int
	default 0 if !RT_LV_FONT_DEFAULT_MONTSERRAT_30
	default 1 if RT_LV_FONT_DEFAULT_MONTSERRAT_30

config LV_FONT_DEFAULT_MONTSERRAT_32
	int
	default 0 if !RT_LV_FONT_DEFAULT_MONTSERRAT_32
	default 1 if RT_LV_FONT_DEFAULT_MONTSERRAT_32

config LV_FONT_DEFAULT_MONTSERRAT_34
	int
	default 0 if !RT_LV_FONT_DEFAULT_MONTSERRAT_34
	default 1 if RT_LV_FONT_DEFAULT_MONTSERRAT_34

config LV_FONT_DEFAULT_MONTSERRAT_36
	int
	default 0 if !RT_LV_FONT_DEFAULT_MONTSERRAT_36
	default 1 if RT_LV_FONT_DEFAULT_MONTSERRAT_36

config LV_FONT_DEFAULT_MONTSERRAT_38
	int
	default 0 if !RT_LV_FONT_DEFAULT_MONTSERRAT_38
	default 1 if RT_LV_FONT_DEFAULT_MONTSERRAT_38

config LV_FONT_DEFAULT_MONTSERRAT_40
	int
	default 0 if !RT_LV_FONT_DEFAULT_MONTSERRAT_40
	default 1 if RT_LV_FONT_DEFAULT_MONTSERRAT_40

config LV_FONT_DEFAULT_MONTSERRAT_42
	int
	default 0 if !RT_LV_FONT_DEFAULT_MONTSERRAT_42
	default 1 if RT_LV_FONT_DEFAULT_MONTSERRAT_42

config LV_FONT_DEFAULT_MONTSERRAT_44
	int
	default 0 if !RT_LV_FONT_DEFAULT_MONTSERRAT_44
	default 1 if RT_LV_FONT_DEFAULT_MONTSERRAT_44

config LV_FONT_DEFAULT_MONTSERRAT_46
	int
	default 0 if !RT_LV_FONT_DEFAULT_MONTSERRAT_46
	default 1 if RT_LV_FONT_DEFAULT_MONTSERRAT_46

config LV_FONT_DEFAULT_MONTSERRAT_48
	int
	default 0 if !RT_LV_FONT_DEFAULT_MONTSERRAT_48
	default 1 if RT_LV_FONT_DEFAULT_MONTSERRAT_48

config LV_FONT_DEFAULT_MONTSERRAT_28_COMPRESSED
	int
	default 0 if !RT_LV_FONT_DEFAULT_MONTSERRAT_28_COMPRESSED
	default 1 if RT_LV_FONT_DEFAULT_MONTSERRAT_28_COMPRESSED

config LV_FONT_DEFAULT_DEJAVU_16_PERSIAN_HEBREW
	int
	default 0 if !RT_LV_FONT_DEFAULT_DEJAVU_16_PERSIAN_HEBREW
	default 1 if RT_LV_FONT_DEFAULT_DEJAVU_16_PERSIAN_HEBREW

config LV_FONT_DEFAULT_SIMSUN_14_CJK
	int
	default 0 if !RT_LV_FONT_DEFAULT_SIMSUN_14_CJK
	default 1 if RT_LV_FONT_DEFAULT_SIMSUN_14_CJK

config LV_FONT_DEFAULT_SIMSUN_16_CJK
	int
	default 0 if !RT_LV_FONT_DEFAULT_SIMSUN_16_CJK
	default 1 if RT_LV_FONT_DEFAULT_SIMSUN_16_CJK

config LV_FONT_DEFAULT_UNSCII_8
	int
	default 0 if !RT_LV_FONT_DEFAULT_UNSCII_8
	default 1 if RT_LV_FONT_DEFAULT_UNSCII_8

config LV_FONT_DEFAULT_UNSCII_16
	int
	default 0 if !RT_LV_FONT_DEFAULT_UNSCII_16
	default 1 if RT_LV_FONT_DEFAULT_UNSCII_16

config LV_FONT_FMT_TXT_LARGE
	int
	default 0 if !RT_LV_FONT_FMT_TXT_LARGE
	default 1 if RT_LV_FONT_FMT_TXT_LARGE

config LV_USE_FONT_COMPRESSED
	int
	default 0 if !RT_LV_USE_FONT_COMPRESSED
	default 1 if RT_LV_USE_FONT_COMPRESSED

config LV_USE_FONT_PLACEHOLDER
	int
	default 0 if !RT_LV_USE_FONT_PLACEHOLDER
	default 1 if RT_LV_USE_FONT_PLACEHOLDER

config LV_USE_BIDI
	int
	default 0 if !RT_LV_USE_BIDI
	default 1 if RT_LV_USE_BIDI

config LV_USE_ARABIC_PERSIAN_CHARS
	int
	default 0 if !RT_LV_USE_ARABIC_PERSIAN_CHARS
	default 1 if RT_LV_USE_ARABIC_PERSIAN_CHARS

config LV_WIDGETS_HAS_DEFAULT_VALUE
	int
	default 0 if !RT_LV_WIDGETS_HAS_DEFAULT_VALUE
	default 1 if RT_LV_WIDGETS_HAS_DEFAULT_VALUE

config LV_USE_ANIMIMG
	int
	default 0 if !RT_LV_USE_ANIMIMG
	default 1 if RT_LV_USE_ANIMIMG

config LV_USE_ARC
	int
	default 0 if !RT_LV_USE_ARC
	default 1 if RT_LV_USE_ARC

config LV_USE_BAR
	int
	default 0 if !RT_LV_USE_BAR
	default 1 if RT_LV_USE_BAR

config LV_USE_BUTTON
	int
	default 0 if !RT_LV_USE_BUTTON
	default 1 if RT_LV_USE_BUTTON

config LV_USE_BUTTONMATRIX
	int
	default 0 if !RT_LV_USE_BUTTONMATRIX
	default 1 if RT_LV_USE_BUTTONMATRIX

config LV_USE_CALENDAR
	int
	default 0 if !RT_LV_USE_CALENDAR
	default 1 if RT_LV_USE_CALENDAR

config LV_CALENDAR_WEEK_STARTS_MONDAY
	int
	default 0 if !RT_LV_CALENDAR_WEEK_STARTS_MONDAY
	default 1 if RT_LV_CALENDAR_WEEK_STARTS_MONDAY

config LV_USE_CALENDAR_HEADER_ARROW
	int
	default 0 if !RT_LV_USE_CALENDAR_HEADER_ARROW
	default 1 if RT_LV_USE_CALENDAR_HEADER_ARROW

config LV_USE_CALENDAR_HEADER_DROPDOWN
	int
	default 0 if !RT_LV_USE_CALENDAR_HEADER_DROPDOWN
	default 1 if RT_LV_USE_CALENDAR_HEADER_DROPDOWN

config LV_USE_CALENDAR_CHINESE
	int
	default 0 if !RT_LV_USE_CALENDAR_CHINESE
	default 1 if RT_LV_USE_CALENDAR_CHINESE

config LV_USE_CANVAS
	int
	default 0 if !RT_LV_USE_CANVAS
	default 1 if RT_LV_USE_CANVAS

config LV_USE_CHART
	int
	default 0 if !RT_LV_USE_CHART
	default 1 if RT_LV_USE_CHART

config LV_USE_CHECKBOX
	int
	default 0 if !RT_LV_USE_CHECKBOX
	default 1 if RT_LV_USE_CHECKBOX

config LV_USE_DROPDOWN
	int
	default 0 if !RT_LV_USE_DROPDOWN
	default 1 if RT_LV_USE_DROPDOWN

config LV_USE_IMAGE
	int
	default 0 if !RT_LV_USE_IMAGE
	default 1 if RT_LV_USE_IMAGE

config LV_USE_IMAGEBUTTON
	int
	default 0 if !RT_LV_USE_IMAGEBUTTON
	default 1 if RT_LV_USE_IMAGEBUTTON

config LV_USE_KEYBOARD
	int
	default 0 if !RT_LV_USE_KEYBOARD
	default 1 if RT_LV_USE_KEYBOARD

config LV_USE_LABEL
	int
	default 0 if !RT_LV_USE_LABEL
	default 1 if RT_LV_USE_LABEL

config LV_LABEL_TEXT_SELECTION
	int
	default 0 if !RT_LV_LABEL_TEXT_SELECTION
	default 1 if RT_LV_LABEL_TEXT_SELECTION

config LV_LABEL_LONG_TXT_HINT
	int
	default 0 if !RT_LV_LABEL_LONG_TXT_HINT
	default 1 if RT_LV_LABEL_LONG_TXT_HINT

config LV_USE_LED
	int
	default 0 if !RT_LV_USE_LED
	default 1 if RT_LV_USE_LED

config LV_USE_LINE
	int
	default 0 if !RT_LV_USE_LINE
	default 1 if RT_LV_USE_LINE

config LV_USE_LIST
	int
	default 0 if !RT_LV_USE_LIST
	default 1 if RT_LV_USE_LIST

config LV_USE_LOTTIE
	int
	default 0 if !RT_LV_USE_LOTTIE
	default 1 if RT_LV_USE_LOTTIE

config LV_USE_MENU
	int
	default 0 if !RT_LV_USE_MENU
	default 1 if RT_LV_USE_MENU

config LV_USE_MSGBOX
	int
	default 0 if !RT_LV_USE_MSGBOX
	default 1 if RT_LV_USE_MSGBOX

config LV_USE_ROLLER
	int
	default 0 if !RT_LV_USE_ROLLER
	default 1 if RT_LV_USE_ROLLER

config LV_USE_SCALE
	int
	default 0 if !RT_LV_USE_SCALE
	default 1 if RT_LV_USE_SCALE

config LV_USE_SLIDER
	int
	default 0 if !RT_LV_USE_SLIDER
	default 1 if RT_LV_USE_SLIDER

config LV_USE_SPAN
	int
	default 0 if !RT_LV_USE_SPAN
	default 1 if RT_LV_USE_SPAN

config LV_USE_SPINBOX
	int
	default 0 if !RT_LV_USE_SPINBOX
	default 1 if RT_LV_USE_SPINBOX

config LV_USE_SPINNER
	int
	default 0 if !RT_LV_USE_SPINNER
	default 1 if RT_LV_USE_SPINNER

config LV_USE_SWITCH
	int
	default 0 if !RT_LV_USE_SWITCH
	default 1 if RT_LV_USE_SWITCH

config LV_USE_TEXTAREA
	int
	default 0 if !RT_LV_USE_TEXTAREA
	default 1 if RT_LV_USE_TEXTAREA

config LV_USE_TABLE
	int
	default 0 if !RT_LV_USE_TABLE
	default 1 if RT_LV_USE_TABLE

config LV_USE_TABVIEW
	int
	default 0 if !RT_LV_USE_TABVIEW
	default 1 if RT_LV_USE_TABVIEW

config LV_USE_TILEVIEW
	int
	default 0 if !RT_LV_USE_TILEVIEW
	default 1 if RT_LV_USE_TILEVIEW

config LV_USE_WIN
	int
	default 0 if !RT_LV_USE_WIN
	default 1 if RT_LV_USE_WIN

config LV_USE_THEME_DEFAULT
	int
	default 0 if !RT_LV_USE_THEME_DEFAULT
	default 1 if RT_LV_USE_THEME_DEFAULT

config LV_THEME_DEFAULT_DARK
	int
	default 0 if !RT_LV_THEME_DEFAULT_DARK
	default 1 if RT_LV_THEME_DEFAULT_DARK

config LV_THEME_DEFAULT_GROW
	int
	default 0 if !RT_LV_THEME_DEFAULT_GROW
	default 1 if RT_LV_THEME_DEFAULT_GROW

config LV_USE_THEME_SIMPLE
	int
	default 0 if !RT_LV_USE_THEME_SIMPLE
	default 1 if RT_LV_USE_THEME_SIMPLE

config LV_USE_THEME_MONO
	int
	default 0 if !RT_LV_USE_THEME_MONO
	default 1 if RT_LV_USE_THEME_MONO

config LV_USE_FLEX
	int
	default 0 if !RT_LV_USE_FLEX
	default 1 if RT_LV_USE_FLEX

config LV_USE_GRID
	int
	default 0 if !RT_LV_USE_GRID
	default 1 if RT_LV_USE_GRID

config LV_USE_FS_STDIO
	int
	default 0 if !RT_LV_USE_FS_STDIO
	default 1 if RT_LV_USE_FS_STDIO

config LV_USE_FS_POSIX
	int
	default 0 if !RT_LV_USE_FS_POSIX
	default 1 if RT_LV_USE_FS_POSIX

config LV_USE_FS_WIN32
	int
	default 0 if !RT_LV_USE_FS_WIN32
	default 1 if RT_LV_USE_FS_WIN32

config LV_USE_FS_FATFS
	int
	default 0 if !RT_LV_USE_FS_FATFS
	default 1 if RT_LV_USE_FS_FATFS

config LV_USE_FS_MEMFS
	int
	default 0 if !RT_LV_USE_FS_MEMFS
	default 1 if RT_LV_USE_FS_MEMFS

config LV_USE_FS_LITTLEFS
	int
	default 0 if !RT_LV_USE_FS_LITTLEFS
	default 1 if RT_LV_USE_FS_LITTLEFS

config LV_USE_FS_ARDUINO_ESP_LITTLEFS
	int
	default 0 if !RT_LV_USE_FS_ARDUINO_ESP_LITTLEFS
	default 1 if RT_LV_USE_FS_ARDUINO_ESP_LITTLEFS

config LV_USE_FS_ARDUINO_SD
	int
	default 0 if !RT_LV_USE_FS_ARDUINO_SD
	default 1 if RT_LV_USE_FS_ARDUINO_SD

config LV_USE_LODEPNG
	int
	default 0 if !RT_LV_USE_LODEPNG
	default 1 if RT_LV_USE_LODEPNG

config LV_USE_LIBPNG
	int
	default 0 if !RT_LV_USE_LIBPNG
	default 1 if RT_LV_USE_LIBPNG

config LV_USE_BMP
	int
	default 0 if !RT_LV_USE_BMP
	default 1 if RT_LV_USE_BMP

config LV_USE_TJPGD
	int
	default 0 if !RT_LV_USE_TJPGD
	default 1 if RT_LV_USE_TJPGD

config LV_USE_LIBJPEG_TURBO
	int
	default 0 if !RT_LV_USE_LIBJPEG_TURBO
	default 1 if RT_LV_USE_LIBJPEG_TURBO

config LV_USE_GIF
	int
	default 0 if !RT_LV_USE_GIF
	default 1 if RT_LV_USE_GIF

config LV_GIF_CACHE_DECODE_DATA
	int
	default 0 if !RT_LV_GIF_CACHE_DECODE_DATA
	default 1 if RT_LV_GIF_CACHE_DECODE_DATA

config LV_BIN_DECODER_RAM_LOAD
	int
	default 0 if !RT_LV_BIN_DECODER_RAM_LOAD
	default 1 if RT_LV_BIN_DECODER_RAM_LOAD

config LV_USE_RLE
	int
	default 0 if !RT_LV_USE_RLE
	default 1 if RT_LV_USE_RLE

config LV_USE_QRCODE
	int
	default 0 if !RT_LV_USE_QRCODE
	default 1 if RT_LV_USE_QRCODE

config LV_USE_BARCODE
	int
	default 0 if !RT_LV_USE_BARCODE
	default 1 if RT_LV_USE_BARCODE

config LV_USE_FREETYPE
	int
	default 0 if !RT_LV_USE_FREETYPE
	default 1 if RT_LV_USE_FREETYPE

config LV_FREETYPE_USE_LVGL_PORT
	int
	default 0 if !RT_LV_FREETYPE_USE_LVGL_PORT
	default 1 if RT_LV_FREETYPE_USE_LVGL_PORT

config LV_USE_TINY_TTF
	int
	default 0 if !RT_LV_USE_TINY_TTF
	default 1 if RT_LV_USE_TINY_TTF

config LV_TINY_TTF_FILE_SUPPORT
	int
	default 0 if !RT_LV_TINY_TTF_FILE_SUPPORT
	default 1 if RT_LV_TINY_TTF_FILE_SUPPORT

config LV_TINY_TTF_CACHE_GLYPH_CNT
	int
	default 0 if !RT_LV_TINY_TTF_CACHE_GLYPH_CNT
	default 1 if RT_LV_TINY_TTF_CACHE_GLYPH_CNT

config LV_USE_RLOTTIE
	int
	default 0 if !RT_LV_USE_RLOTTIE
	default 1 if RT_LV_USE_RLOTTIE

config LV_USE_THORVG
	int
	default 0 if !RT_LV_USE_THORVG
	default 1 if RT_LV_USE_THORVG

config LV_USE_THORVG_INTERNAL
	int
	default 0 if !RT_LV_USE_THORVG_INTERNAL
	default 1 if RT_LV_USE_THORVG_INTERNAL

config LV_USE_THORVG_EXTERNAL
	int
	default 0 if !RT_LV_USE_THORVG_EXTERNAL
	default 1 if RT_LV_USE_THORVG_EXTERNAL

config LV_USE_LZ4
	int
	default 0 if !RT_LV_USE_LZ4
	default 1 if RT_LV_USE_LZ4

config LV_USE_LZ4_INTERNAL
	int
	default 0 if !RT_LV_USE_LZ4_INTERNAL
	default 1 if RT_LV_USE_LZ4_INTERNAL

config LV_USE_LZ4_EXTERNAL
	int
	default 0 if !RT_LV_USE_LZ4_EXTERNAL
	default 1 if RT_LV_USE_LZ4_EXTERNAL

config LV_USE_SNAPSHOT
	int
	default 0 if !RT_LV_USE_SNAPSHOT
	default 1 if RT_LV_USE_SNAPSHOT

config LV_USE_SYSMON
	int
	default 0 if !RT_LV_USE_SYSMON
	default 1 if RT_LV_USE_SYSMON

config LV_USE_PERF_MONITOR
	int
	default 0 if !RT_LV_USE_PERF_MONITOR
	default 1 if RT_LV_USE_PERF_MONITOR

config LV_USE_PERF_MONITOR_LOG_MODE
	int
	default 0 if !RT_LV_USE_PERF_MONITOR_LOG_MODE
	default 1 if RT_LV_USE_PERF_MONITOR_LOG_MODE

config LV_USE_MEM_MONITOR
	int
	default 0 if !RT_LV_USE_MEM_MONITOR
	default 1 if RT_LV_USE_MEM_MONITOR

config LV_USE_PROFILER
	int
	default 0 if !RT_LV_USE_PROFILER
	default 1 if RT_LV_USE_PROFILER

config LV_USE_PROFILER_BUILTIN
	int
	default 0 if !RT_LV_USE_PROFILER_BUILTIN
	default 1 if RT_LV_USE_PROFILER_BUILTIN

config LV_USE_MONKEY
	int
	default 0 if !RT_LV_USE_MONKEY
	default 1 if RT_LV_USE_MONKEY

config LV_USE_GRIDNAV
	int
	default 0 if !RT_LV_USE_GRIDNAV
	default 1 if RT_LV_USE_GRIDNAV

config LV_USE_FRAGMENT
	int
	default 0 if !RT_LV_USE_FRAGMENT
	default 1 if RT_LV_USE_FRAGMENT

config LV_USE_IMGFONT
	int
	default 0 if !RT_LV_USE_IMGFONT
	default 1 if RT_LV_USE_IMGFONT

config LV_USE_OBSERVER
	int
	default 0 if !RT_LV_USE_OBSERVER
	default 1 if RT_LV_USE_OBSERVER

config LV_USE_IME_PINYIN
	int
	default 0 if !RT_LV_USE_IME_PINYIN
	default 1 if RT_LV_USE_IME_PINYIN

config LV_IME_PINYIN_USE_K9_MODE
	int
	default 0 if !RT_LV_IME_PINYIN_USE_K9_MODE
	default 1 if RT_LV_IME_PINYIN_USE_K9_MODE

config LV_IME_PINYIN_USE_DEFAULT_DICT
	int
	default 0 if !RT_LV_IME_PINYIN_USE_DEFAULT_DICT
	default 1 if RT_LV_IME_PINYIN_USE_DEFAULT_DICT

config LV_USE_FILE_EXPLORER
	int
	default 0 if !RT_LV_USE_FILE_EXPLORER
	default 1 if RT_LV_USE_FILE_EXPLORER

config LV_FILE_EXPLORER_QUICK_ACCESS
	int
	default 0 if !RT_LV_FILE_EXPLORER_QUICK_ACCESS
	default 1 if RT_LV_FILE_EXPLORER_QUICK_ACCESS

config LV_USE_SDL
	int
	default 0 if !RT_LV_USE_SDL
	default 1 if RT_LV_USE_SDL

config LV_SDL_RENDER_MODE_PARTIAL
	int
	default 0 if !RT_LV_SDL_RENDER_MODE_PARTIAL
	default 1 if RT_LV_SDL_RENDER_MODE_PARTIAL

config LV_SDL_RENDER_MODE_DIRECT
	int
	default 0 if !RT_LV_SDL_RENDER_MODE_DIRECT
	default 1 if RT_LV_SDL_RENDER_MODE_DIRECT

config LV_SDL_RENDER_MODE_FULL
	int
	default 0 if !RT_LV_SDL_RENDER_MODE_FULL
	default 1 if RT_LV_SDL_RENDER_MODE_FULL

config LV_SDL_ACCELERATED
	int
	default 0 if !RT_LV_SDL_ACCELERATED
	default 1 if RT_LV_SDL_ACCELERATED

config LV_SDL_FULLSCREEN
	int
	default 0 if !RT_LV_SDL_FULLSCREEN
	default 1 if RT_LV_SDL_FULLSCREEN

config LV_SDL_DIRECT_EXIT
	int
	default 0 if !RT_LV_SDL_DIRECT_EXIT
	default 1 if RT_LV_SDL_DIRECT_EXIT

config LV_USE_X11
	int
	default 0 if !RT_LV_USE_X11
	default 1 if RT_LV_USE_X11

config LV_X11_DOUBLE_BUFFER
	int
	default 0 if !RT_LV_X11_DOUBLE_BUFFER
	default 1 if RT_LV_X11_DOUBLE_BUFFER

config LV_X11_DIRECT_EXIT
	int
	default 0 if !RT_LV_X11_DIRECT_EXIT
	default 1 if RT_LV_X11_DIRECT_EXIT

config LV_USE_WAYLAND
	int
	default 0 if !RT_LV_USE_WAYLAND
	default 1 if RT_LV_USE_WAYLAND

config LV_WAYLAND_WINDOW_DECORATIONS
	int
	default 0 if !RT_LV_WAYLAND_WINDOW_DECORATIONS
	default 1 if RT_LV_WAYLAND_WINDOW_DECORATIONS

config LV_WAYLAND_WL_SHELL
	int
	default 0 if !RT_LV_WAYLAND_WL_SHELL
	default 1 if RT_LV_WAYLAND_WL_SHELL

config LV_USE_LINUX_FBDEV
	int
	default 0 if !RT_LV_USE_LINUX_FBDEV
	default 1 if RT_LV_USE_LINUX_FBDEV

config LV_LINUX_FBDEV_BSD
	int
	default 0 if !RT_LV_LINUX_FBDEV_BSD
	default 1 if RT_LV_LINUX_FBDEV_BSD

config LV_USE_NUTTX
	int
	default 0 if !RT_LV_USE_NUTTX
	default 1 if RT_LV_USE_NUTTX

config LV_USE_NUTTX_LIBUV
	int
	default 0 if !RT_LV_USE_NUTTX_LIBUV
	default 1 if RT_LV_USE_NUTTX_LIBUV

config LV_USE_NUTTX_CUSTOM_INIT
	int
	default 0 if !RT_LV_USE_NUTTX_CUSTOM_INIT
	default 1 if RT_LV_USE_NUTTX_CUSTOM_INIT

config LV_USE_NUTTX_LCD
	int
	default 0 if !RT_LV_USE_NUTTX_LCD
	default 1 if RT_LV_USE_NUTTX_LCD

config LV_USE_NUTTX_TOUCHSCREEN
	int
	default 0 if !RT_LV_USE_NUTTX_TOUCHSCREEN
	default 1 if RT_LV_USE_NUTTX_TOUCHSCREEN

config LV_USE_LINUX_DRM
	int
	default 0 if !RT_LV_USE_LINUX_DRM
	default 1 if RT_LV_USE_LINUX_DRM

config LV_USE_TFT_ESPI
	int
	default 0 if !RT_LV_USE_TFT_ESPI
	default 1 if RT_LV_USE_TFT_ESPI

config LV_USE_EVDEV
	int
	default 0 if !RT_LV_USE_EVDEV
	default 1 if RT_LV_USE_EVDEV

config LV_USE_LIBINPUT
	int
	default 0 if !RT_LV_USE_LIBINPUT
	default 1 if RT_LV_USE_LIBINPUT

config LV_LIBINPUT_BSD
	int
	default 0 if !RT_LV_LIBINPUT_BSD
	default 1 if RT_LV_LIBINPUT_BSD

config LV_LIBINPUT_XKB
	int
	default 0 if !RT_LV_LIBINPUT_XKB
	default 1 if RT_LV_LIBINPUT_XKB

config LV_USE_ST7735
	int
	default 0 if !RT_LV_USE_ST7735
	default 1 if RT_LV_USE_ST7735

config LV_USE_ST7789
	int
	default 0 if !RT_LV_USE_ST7789
	default 1 if RT_LV_USE_ST7789

config LV_USE_ST7796
	int
	default 0 if !RT_LV_USE_ST7796
	default 1 if RT_LV_USE_ST7796

config LV_USE_ILI9341
	int
	default 0 if !RT_LV_USE_ILI9341
	default 1 if RT_LV_USE_ILI9341

config LV_USE_GENERIC_MIPI
	int
	default 0 if !RT_LV_USE_GENERIC_MIPI
	default 1 if RT_LV_USE_GENERIC_MIPI

config LV_USE_RENESAS_GLCDC
	int
	default 0 if !RT_LV_USE_RENESAS_GLCDC
	default 1 if RT_LV_USE_RENESAS_GLCDC

config LV_USE_WINDOWS
	int
	default 0 if !RT_LV_USE_WINDOWS
	default 1 if RT_LV_USE_WINDOWS

config LV_USE_OPENGLES
	int
	default 0 if !RT_LV_USE_OPENGLES
	default 1 if RT_LV_USE_OPENGLES

config LV_USE_OPENGLES_DEBUG
	int
	default 0 if !RT_LV_USE_OPENGLES_DEBUG
	default 1 if RT_LV_USE_OPENGLES_DEBUG

config LV_USE_QNX
	int
	default 0 if !RT_LV_USE_QNX
	default 1 if RT_LV_USE_QNX

config LV_BUILD_EXAMPLES
	int
	default 0 if !RT_LV_BUILD_EXAMPLES
	default 1 if RT_LV_BUILD_EXAMPLES

config LV_USE_DEMO_WIDGETS
	int
	default 0 if !RT_LV_USE_DEMO_WIDGETS
	default 1 if RT_LV_USE_DEMO_WIDGETS

config LV_USE_DEMO_KEYPAD_AND_ENCODER
	int
	default 0 if !RT_LV_USE_DEMO_KEYPAD_AND_ENCODER
	default 1 if RT_LV_USE_DEMO_KEYPAD_AND_ENCODER

config LV_USE_DEMO_BENCHMARK
	int
	default 0 if !RT_LV_USE_DEMO_BENCHMARK
	default 1 if RT_LV_USE_DEMO_BENCHMARK

config LV_USE_DEMO_RENDER
	int
	default 0 if !RT_LV_USE_DEMO_RENDER
	default 1 if RT_LV_USE_DEMO_RENDER

config LV_USE_DEMO_SCROLL
	int
	default 0 if !RT_LV_USE_DEMO_SCROLL
	default 1 if RT_LV_USE_DEMO_SCROLL

config LV_USE_DEMO_STRESS
	int
	default 0 if !RT_LV_USE_DEMO_STRESS
	default 1 if RT_LV_USE_DEMO_STRESS

config LV_USE_DEMO_TRANSFORM
	int
	default 0 if !RT_LV_USE_DEMO_TRANSFORM
	default 1 if RT_LV_USE_DEMO_TRANSFORM

config LV_USE_DEMO_MUSIC
	int
	default 0 if !RT_LV_USE_DEMO_MUSIC
	default 1 if RT_LV_USE_DEMO_MUSIC

config LV_DEMO_MUSIC_SQUARE
	int
	default 0 if !RT_LV_DEMO_MUSIC_SQUARE
	default 1 if RT_LV_DEMO_MUSIC_SQUARE

config LV_DEMO_MUSIC_LANDSCAPE
	int
	default 0 if !RT_LV_DEMO_MUSIC_LANDSCAPE
	default 1 if RT_LV_DEMO_MUSIC_LANDSCAPE

config LV_DEMO_MUSIC_ROUND
	int
	default 0 if !RT_LV_DEMO_MUSIC_ROUND
	default 1 if RT_LV_DEMO_MUSIC_ROUND

config LV_DEMO_MUSIC_LARGE
	int
	default 0 if !RT_LV_DEMO_MUSIC_LARGE
	default 1 if RT_LV_DEMO_MUSIC_LARGE

config LV_DEMO_MUSIC_AUTO_PLAY
	int
	default 0 if !RT_LV_DEMO_MUSIC_AUTO_PLAY
	default 1 if RT_LV_DEMO_MUSIC_AUTO_PLAY

config LV_USE_DEMO_FLEX_LAYOUT
	int
	default 0 if !RT_LV_USE_DEMO_FLEX_LAYOUT
	default 1 if RT_LV_USE_DEMO_FLEX_LAYOUT

config LV_USE_DEMO_MULTILANG
	int
	default 0 if !RT_LV_USE_DEMO_MULTILANG
	default 1 if RT_LV_USE_DEMO_MULTILANG

config LV_USE_DEMO_VECTOR_GRAPHIC
	int
	default 0 if !RT_LV_USE_DEMO_VECTOR_GRAPHIC
	default 1 if RT_LV_USE_DEMO_VECTOR_GRAPHIC
```
