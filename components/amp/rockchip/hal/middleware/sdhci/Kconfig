## components/amp/rockchip/hal/middleware/sdhci/Kconfig
```kconfig
config RT_USING_SDHCI
    bool "Enable sdhci"
    default n
    help
        Select this option to enable sdhci
```

## components/amp/rockchip/rt-thread/applications/smart_meeting/Kconfig
```kconfig
config SMART_MEETING_UAC_ENABLE
    bool "Enable UAC function in smart metting"
    default y

    if SMART_MEETING_UAC_ENABLE
        config SMART_MEETING_CAPTURE_CARD
            string "capture card name"
            default "combc"
        config SMART_MEETING_PLAYBACK_CARD
            string "playback card name"
            default "es8156p"
    endif

config SMART_MEETING_RKAUDIO
    bool "Enable RK Audio function"
    default y

config SMART_MEETING_RKSTUDIO_GAIN
    bool "Enable RK Studio gain function"
    default y

config SMART_MEETING_RKSTUDIO_EQDRC
    bool "Enable RK Studio eq & drc function"
    default y

config SMART_MEETING_WDT_ENABLE
    bool "Enable WDT function"
    select RT_USING_WDT
    default y
```

## components/amp/rockchip/rt-thread/bsp/rockchip/rk3588-32/driver/Kconfig
```kconfig
source "$BSP_DIR/../common/drivers/Kconfig"

menu "RT-Thread rockchip RK3588 drivers"

config RT_USING_CACHE_ECC
    bool "Enable Cache ECC"
    default n

menu "Enable CAN"
    config RT_USING_CAN
        bool "Enable CAN"
        default n

    if RT_USING_CAN
    config RT_USING_CAN1
        bool "Enable CAN1"
        default n
    endif
endmenu

config RT_USING_CRU
    bool "Enable CRU"
    default n

config RT_USING_DMA
    bool "Enable General DMA Framework"
    default n

if RT_USING_DMA
config RT_USING_DMA_PL330
    bool "Enable PL330 DMA Controller"
    default n

config RT_USING_DMA0
    bool "Enable PL330 DMA0 Controller"
    default n

config RT_USING_DMA1
    bool "Enable PL330 DMA1 Controller"
    default n
endif

menu "Enable GMAC"
    config RT_USING_GMAC
        bool "Enable GMAC"
        select RT_USING_LWIP
        default n

    if RT_USING_GMAC
    config RT_USING_GMAC0
        bool "Enable GMAC0"
        default n
    config RT_USING_GMAC1
        bool "Enable GMAC1"
        default n
    endif
endmenu

config RT_USING_PMU
    bool "Enable PMU"
    default y

config RT_USING_SYSTICK
    bool "Enable SYSTICK"
    default y

menu "Enable UART"
    config RT_USING_UART
        bool "Enable UART"
        default y

    if RT_USING_UART
    config RT_USING_UART2
        bool "Enable UART2"
        default y

    config RT_USING_UART4
        bool "Enable UART4"
        default n

    config RT_USING_UART5
        bool "Enable UART5"
        default n
    endif
endmenu

config RT_USING_DW_PCIE
    bool "Enable DW PCIE"
    default n

config RT_USING_PCIE_DMA
    bool "Enable PCIE DMA"
    default n

menu "Enable Audio Card"
    config RT_USING_AUDIO_CARD_I2S0_8CH
       bool "Enable TDM0 Digital audio card"
       select RT_USING_I2STDM0
       default n

    config RT_USING_AUDIO_CARD_I2S1_8CH
       bool "Enable TDM1 Digital audio card"
       select RT_USING_I2STDM1
       default n

menu "Audio Interfaces"
    config RT_USING_I2STDM
        bool

    config RT_USING_I2STDM0
        bool
        select RT_USING_I2STDM

    config RT_USING_I2STDM1
        bool
        select RT_USING_I2STDM

    config RT_USING_PCM
        bool
        select RT_USING_DMA
        default y
endmenu
endmenu
endmenu
```

## components/amp/rockchip/rt-thread/bsp/rockchip/rk3588-mcu/Kconfig
```kconfig
mainmenu "RT-Thread Configuration"

config BSP_DIR
    string
    option env="BSP_ROOT"
    default "."

config RTT_DIR
    string
    option env="RTT_ROOT"
    default "../../.."

config PKGS_DIR
    string
    option env="PKGS_ROOT"
    default "packages"

choice
    prompt "RK3588 MCU"
    default RKMCU_RK3588_PMU

    config RKMCU_RK3588_PMU
        select ARCH_ARM_CORTEX_M0
        bool "RK3588 MCU of PMU"

    config RKMCU_RK3588_NPU
        select ARCH_ARM_CORTEX_M0
        bool "RK3588 MCU of NPU"

    config RKMCU_RK3588_DDR
        select ARCH_ARM_CORTEX_M0
        bool "RK3588 MCU of DDR(no cache)"
endchoice

source "$RTT_DIR/Kconfig"
source "$BSP_DIR/drivers/Kconfig"
source "$BSP_DIR/board/Kconfig"
#source "$PKGS_DIR/Kconfig"
source "$BSP_DIR/../common/tests/Kconfig"
```

## components/amp/rockchip/rt-thread/bsp/rockchip/rk3588-mcu/drivers/Kconfig
```kconfig
source "$BSP_DIR/../common/drivers/Kconfig"

menu "RT-Thread rockchip rk3588_mcu drivers"

config RT_USING_CRU
    bool "Enable CRU"
    default n

menu "Enable UART"
    config RT_USING_UART
        bool "Enable UART"
        default n

    if RT_USING_UART
    config RT_USING_UART0
        bool "Enable UART0"
        default n
    config RT_USING_UART2
        bool "Enable UART2"
        default n
    endif
endmenu

endmenu
```

## components/amp/rockchip/rt-thread/components/cJSON/Kconfig
```kconfig
config RT_USING_CJSON
    bool "Enable cJSON"
    default n
    help
        Select this option to enable cJSON
```
