/dts-v1/;
/plugin/;

/ {
	fragment@0 {
		target = <&spicc1>;
		__overlay__ {
			status = "okay";
			pinctrl-names = "default";
			pinctrl-0 = <&spicc1_pins>, <&spicc1_ss0_pins>;
			#address-cells = <1>;
			#size-cells = <0>;

			spidev@0 {
				compatible = "rohm,dh2228fv";
				reg = <0>;
				spi-max-frequency = <24000000>;
			};
		};
	};
};
